#include "stm32f10x.h"
#include "delay.h"

/*-----------------------------------------------------------------------
Delay_us  			 								: 滴答定时器延时1us
	
输入参数                   			：us

                                 由于 SysTick->LOAD 的值最大为2^24 故延时时间参数us最大只能等于233016
																 
编写日期                        	：2018年11月19日
最后修改日期                  		：2018年11月21日
-----------------------------------------------------------------------*/
void Delay_us(unsigned int us)
{
	SysTick->LOAD=72*us;                                   //重装计数初值（当主频是72MHz，72次为1微秒）
	SysTick->VAL=0x00;                                     //清空定时器的计数器
	SysTick->CTRL=0x00000005;                              //时钟源HCLK，打开定时器
	while(!(SysTick->CTRL&0x00010000));                    //等待计数到0
	SysTick->CTRL=0x00000004;                              //关闭定时器
}
/*-----------------------------------------------------------------------
Delay_ms  			 								: 滴答定时器延时1ms
	
输入参数                   			：ms
                                  
编写日期                        	：2018年11月19日
最后修改日期                  		：2018年11月21日
-----------------------------------------------------------------------*/
void Delay_ms(unsigned int ms)
{
	while( ms-- != 0)
	{
		Delay_us(1000);	                                     //调用1000微秒的延时
	}
}
/*-----------------------------------------------------------------------
Delay_m   			 								: 滴答定时器延时1s
	
输入参数                   			：s
                                  
编写日期                        	：2018年11月19日
最后修改日期                  		：2018年11月21日
-----------------------------------------------------------------------*/
void Delay_s(unsigned int s)
{
	while( s-- != 0)
	{
		Delay_ms(1000);	                                    //调用1000微秒的延时
	}
}
/*-----------------------------------------------------------------------
Delay  			 									  : 大约延时1ms
	
输入参数                   			：无
                                  
编写日期                        	：2018年11月19日
最后修改日期                  		：2018年11月19日
-----------------------------------------------------------------------*/
void Delay(uint16_t time)
{	
  uint16_t i = 0;
	while(time--)
	{
		i=7997;
		while(i--);
	}
}
/*-----------------------------------------------------------------------
delay_us  			 							  : 微秒延时函数  SysTick_Config(uint32_t ticks)
																								ticks最大不能超过16777215 即2^24
	
输入参数                   			：time 延时时间
                                  
编写日期                        	：2018年11月21日
最后修改日期                  		：2018年11月21日
-----------------------------------------------------------------------*/
void delay_us(uint32_t time)
{
	uint32_t i;
//	SysTick->LOAD = 72;                                  // 重装载值设置为72（时钟频率为72MHz）（最大不能超过16777215）
//	SysTick->VAL = 0x00; 																 // 当前数值
//	SysTick->CTRL=0x00000005;                            // 101 第二位时钟选择位，1=处理器时钟AHB，第0位使能Systick
	SysTick_Config(72);
	for(i=0;i<time;i++)
	{
		while(!(SysTick->CTRL&(1<<16)));
	}
	SysTick->CTRL=0x00000004;                              //关闭定时器
}
/*-----------------------------------------------------------------------
delay_ms  			 							  : 微秒延时函数   SysTick_Config(uint32_t ticks)
	
																								ticks最大不能超过16777215 即2^24
	
输入参数                   			：time 延时时间
                                  
编写日期                        	：2018年11月21日
最后修改日期                  		：2018年11月21日
-----------------------------------------------------------------------*/
void delay_ms(uint32_t time)
{
	uint32_t i;
//	SysTick->LOAD = 72;                                  // 重装载值设置为72（时钟频率为72MHz）
//	SysTick->VAL = 0x00; 																 // 当前数值
//	SysTick->CTRL=0x00000005;                            // 101 第二位时钟选择位，1=处理器时钟AHB，第0位使能Systick
	SysTick_Config(72000);
	for(i=0;i<time;i++)
	{
		while(!(SysTick->CTRL&(1<<16)));
	}
	SysTick->CTRL=0x00000004;                              //关闭定时器
}
